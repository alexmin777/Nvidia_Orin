## R35.1/sources/kernel/nvidia/drivers/media/i2c/gmsl/Kconfig
```kconfig
if VIDEO_V4L2

menu "gmsl test driver by alex"
	visible if !MEDIA_SUBDRV_AUTOSELECT || COMPILE_TEST

config NV_VIDEO_AR0233
	tristate "AR0233 camera sensor support"
	depends on I2C && VIDEO_V4L2 && VIDEO_V4L2_SUBDEV_API && I2C_IOEXPANDER_SER_NV_MAX9295 && I2C_IOEXPANDER_DESER_MAX96712
	help
	  This is a Video4Linux2 sensor-level driver for the ON Semiconductor
	  AR0233 camera sensor

	  To compile this driver as a module, choose M here: the module
	  will be called ar0233.
endmenu

endif
```
